## arch/arm/boards/netx4000/Kconfig
```kconfig
#
# netX4000 Architecture specific features
#
# (C) Copyright 2014
# Hilscher Gesellschaft fuer Systemautomation mbH, <www.hilscher.com>
#
# This program is free software; you can redistribute it and/or
# modify it under the terms of the GNU General Public License as
# published by the Free Software Foundation; either version 2 of
# the License, or (at your option) any later version.
#
# This program is distributed in the hope that it will be useful,
# but WITHOUT ANY WARRANTY; without even the implied warranty of
# MERCHANTABILITY or FITNESS FOR A PARTICULAR PURPOSE. See the
# GNU General Public License for more details.
#

choice
	prompt "DDR RAM Type"

config DDR_RAM_AS4C512M16D3L_12_2GIB
	bool "2GiB (AS4C512M16D3L-12)"

config DDR_RAM_IS43TR16256AL_1GIB
	bool "1GiB (IS43TR16256A)"

config DDR_RAM_OUT_OF_TREE
	bool "Out of tree DDR RAM parameters."
	help
		Select this to provide your own specific DDR RAM timing parameters.

endchoice

config DDR_RAM_OUT_OF_TREE_INCLUDE_400
	string "Include file for out of tree DDR RAM parameters (400MHz)."
	default "mach/as4c512m16d3l-12-2gib-400mhz.h"
	depends on DDR_RAM_OUT_OF_TREE

config DDR_RAM_OUT_OF_TREE_INCLUDE_600
	string "Include file for out of tree DDR RAM parameters (600MHz)."
	default "mach/as4c512m16d3l-12-2gib-600mhz"
	depends on DDR_RAM_OUT_OF_TREE

config DDR400_RAM_INCLUDE
	string
	default "mach/as4c512m16d3l-12-2gib-400mhz.h" if DDR_RAM_AS4C512M16D3L_12_2GIB
	default "mach/is43tr16256al-1gib-400mhz.h" if DDR_RAM_IS43TR16256AL_1GIB
	default DDR_RAM_OUT_OF_TREE_INCLUDE_400 if DDR_RAM_OUT_OF_TREE

config DDR600_RAM_INCLUDE
	string
	default "mach/as4c512m16d3l-12-2gib-600mhz.h" if DDR_RAM_AS4C512M16D3L_12_2GIB
	default "mach/is43tr16256al-1gib-600mhz.h" if DDR_RAM_IS43TR16256AL_1GIB
	default DDR_RAM_OUT_OF_TREE_INCLUDE_600 if DDR_RAM_OUT_OF_TREE

config ENABLE_DDR_ECC
	bool "Enable ecc for DDR-RAM"
	default n
	help
		Enables ecc for DDR-RAM.
		NOTE: This feature will slow down the boot process due to the memory initialization time.
```

## arch/arm/configs/netx4000_defconfig
```kconfig
CONFIG_TEXT_BASE=0x05000000
CONFIG_BUILTIN_DTB=y
CONFIG_BUILTIN_DTB_NAME="netx4000/dummy"
CONFIG_ARCH_NETX4000=y
CONFIG_CACHE_L2X0=y
CONFIG_BAREBOX_MAX_IMAGE_SIZE=0x70000
CONFIG_DDR_RAM_IS43TR16256AL_1GIB=y
CONFIG_ENABLE_DDR_ECC=y
CONFIG_SWFPUABI=y
CONFIG_FPUTYPE="neon"
CONFIG_THUMB2_BAREBOX=y
CONFIG_ARM_OPTIMZED_STRING_FUNCTIONS=y
CONFIG_MMU=y
CONFIG_STACK_SIZE=0x4000
CONFIG_MALLOC_SIZE=0x04000000
CONFIG_GLOB=y
CONFIG_CMDLINE_EDITING=y
CONFIG_AUTO_COMPLETE=y
CONFIG_MENU=y
CONFIG_BOOTM_INITRD=y
CONFIG_BOOTM_OFTREE=y
CONFIG_BOOTM_FITIMAGE=y
CONFIG_BOOTM_FITIMAGE_SIGNATURE=y
CONFIG_FLEXIBLE_BOOTARGS=y
CONFIG_DEFAULT_ENVIRONMENT_PATH="arch/arm/boards/netx4000/env"
CONFIG_POLLER=y
CONFIG_DEBUG_INFO=y
CONFIG_LONGHELP=y
CONFIG_CMD_BOOT=y
CONFIG_CMD_BOOTZ=y
CONFIG_CMD_PARTITION=y
CONFIG_CMD_EXPORT=y
CONFIG_CMD_GLOBAL=y
CONFIG_CMD_LOADENV=y
CONFIG_CMD_PRINTENV=y
CONFIG_CMD_MAGICVAR=y
CONFIG_CMD_MAGICVAR_HELP=y
CONFIG_CMD_SAVEENV=y
CONFIG_CMD_BASENAME=y
CONFIG_CMD_READLINK=y
CONFIG_CMD_SHA256SUM=y
CONFIG_CMD_SHA512SUM=y
CONFIG_CMD_LET=y
CONFIG_CMD_READF=y
CONFIG_CMD_DHCP=y
CONFIG_CMD_HOST=y
CONFIG_NET_CMD_IFUP=y
CONFIG_CMD_PING=y
CONFIG_CMD_ECHO_E=y
CONFIG_CMD_EDIT=y
CONFIG_CMD_MENU=y
CONFIG_CMD_MENU_MANAGEMENT=y
CONFIG_CMD_TIMEOUT=y
CONFIG_CMD_FLASH=y
CONFIG_CMD_I2C=y
CONFIG_NET=y
CONFIG_OFDEVICE=y
CONFIG_OF_BAREBOX_DRIVERS=y
CONFIG_OF_BAREBOX_ENV_IN_FS=y
CONFIG_SERIAL_AMBA_PL011=y
CONFIG_DRIVER_NET_GMAC_NETX4000=y
CONFIG_MDIO_BITBANG=y
CONFIG_MDIO_GPIO=y
CONFIG_I2C=y
CONFIG_I2C_NETX4000=y
CONFIG_USB_HOST=y
CONFIG_USB_EHCI=y
CONFIG_USB_EHCI_NETX4000=y
CONFIG_USB_STORAGE=y
CONFIG_MCI=y
CONFIG_MCI_STARTUP=y
CONFIG_MCI_NETX4000=y
CONFIG_SRAM=y
CONFIG_GPIO_NETX4000=y
CONFIG_FS_EXT4=y
CONFIG_FS_FAT=y
CONFIG_FS_FAT_WRITE=y
CONFIG_FS_FAT_LFN=y
CONFIG_ZLIB=y
CONFIG_LZO_DECOMPRESS=y
CONFIG_DIGEST_SHA256_ARM=y
CONFIG_DIGEST_SHA512_ARM=y
```

## arch/arm/mach-netx4000/Kconfig
```kconfig
#
# netX4000 Architecture specific features
#
# (C) Copyright 2014
# Hilscher Gesellschaft fuer Systemautomation mbH, <www.hilscher.com>
#
# This program is free software; you can redistribute it and/or
# modify it under the terms of the GNU General Public License as
# published by the Free Software Foundation; either version 2 of
# the License, or (at your option) any later version.
#
# This program is distributed in the hope that it will be useful,
# but WITHOUT ANY WARRANTY; without even the implied warranty of
# MERCHANTABILITY or FITNESS FOR A PARTICULAR PURPOSE. See the
# GNU General Public License for more details.
#

menu "netX4000 Options"
	depends on ARCH_NETX4000

config ARCH_TEXT_BASE
	hex
	default 0x05001000

choice
	prompt "Select netX4000 board type"

config MACH_NETX4000
	bool "netX4000 generic"
	help
	  Say Y here if you are using netX4000 platform

endchoice

source arch/arm/boards/netx4000/Kconfig

endmenu
```
